## build/Kconfig/boards/Kconfig
```kconfig
# Load Zephyr board Kconfig descriptions.
osource "C:/Users/fyaih/zephyrproject/zephyr/boards/nxp/frdm_kl25z/Kconfig"
```

## build/Kconfig/boards/Kconfig.defconfig
```kconfig
# Load Zephyr board defconfig descriptions.
osource "C:/Users/fyaih/zephyrproject/zephyr/boards/nxp/frdm_kl25z/Kconfig.defconfig"
```

## build/Kconfig/boards/Kconfig.frdm_kl25z
```kconfig
# Load board Kconfig descriptions.
osource "C:/Users/fyaih/zephyrproject/zephyr/boards/nxp/frdm_kl25z/Kconfig.frdm_kl25z"
```
